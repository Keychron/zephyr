## modules/Kconfig.realtek
```kconfig
# Copyright(c) 2020, Realtek Semiconductor Corporation.
# SPDX-License-Identifier: Apache-2.0

config ZEPHYR_HAL_REALTEK_MODULE
	bool

config USE_HAL_REALTEK_ADC
	bool
	help
	  Enable HAL REALTEK ADC driver

config USE_HAL_REALTEK_TIM
	bool
	help
	  Enable HAL REALTEK TIM driver

config USE_HAL_REALTEK_ENHTIM
	bool "Enable HAL REALTEK ENHTIM driver"
	help
	  Enable HAL REALTEK ENHTIM driver

config USE_HAL_REALTEK_RTC
	bool
	help
	  Enable HAL REALTEK RTC driver

config USE_HAL_REALTEK_DMA
	bool
	help
	  Enable HAL REALTEK DMA driver

config USE_HAL_REALTEK_GPIO
	bool
	help
	  Enable HAL REALTEK GPIO driver

config USE_HAL_REALTEK_I2C
	bool
	help
	  Enable HAL REALTEK I2C driver

config USE_HAL_REALTEK_KEYSCAN
	bool
	help
	  Enable HAL REALTEK KEYSCAN driver

config USE_HAL_REALTEK_AON_QDEC
	bool
	help
	  Enable HAL REALTEK AON QDEC driver

config USE_HAL_REALTEK_UART
	bool
	help
	  Enable HAL REALTEK UART driver

config USE_HAL_REALTEK_SPI
	bool
	help
	  Enable HAL REALTEK SPI driver

config USE_HAL_REALTEK_USB
	bool
	help
	  Enable HAL REALTEK USB driver

config USE_HAL_REALTEK_AON_WDT
	bool
	help
	  Enable HAL REALTEK AON WDT driver

config USE_HAL_REALTEK_CORE_WDT
	bool
	help
	  Enable HAL REALTEK CORE WDT driver

config USE_HAL_REALTEK_RCC
	bool
	help
	  Enable HAL REALTEK RCC driver

config USE_HAL_REALTEK_NVIC
	bool
	help
	  Enable HAL REALTEK NVIC driver

config USE_HAL_REALTEK_PINMUX
	bool
	help
	  Enable HAL REALTEK PINMUX driver
```

## soc/arm/realtek_bee/rtl87x2g/Kconfig.defconfig.series
```kconfig
if SOC_SERIES_RTL87X2G

config SOC_SERIES
	default "rtl87x2g"

config SOC_PART_NUMBER
	default "rtl8762gku" if SOC_PART_NUMBER_RTL8762GKU
	default "rtl8762gkh" if SOC_PART_NUMBER_RTL8762GKH
	default "rtl8762gn" if SOC_PART_NUMBER_RTL8762GN
	default "rtl8762gtp" if SOC_PART_NUMBER_RTL8762GTP
	default "rtl8762gtu" if SOC_PART_NUMBER_RTL8762GTU
	default "rtl8762gth" if SOC_PART_NUMBER_RTL8762GTH
	default "rtl8772gwf" if SOC_PART_NUMBER_RTL8772GWF
	default "rtl8772gwp" if SOC_PART_NUMBER_RTL8772GWP
	default "rtl8777g" if SOC_PART_NUMBER_RTL8777G

config NUM_IRQS
	int
	default 109

config SYS_CLOCK_HW_CYCLES_PER_SEC
	int
	default 32000 if SYSTICK_USE_EXTERNAL_CLOCK
    default 40000000 if SYSTICK_USE_CPU_CLOCK

config SYS_CLOCK_TICKS_PER_SEC
	int
	default 100
    #10ms/1tick
	
config ARCH_HAS_CUSTOM_BUSY_WAIT
	default y

config IDLE_STACK_SIZE
    default 1024

config NUM_METAIRQ_PRIORITIES
	default 1

rsource "Kconfig.defconfig.rtl87*"

endif # SOC_SERIES_RTL87X2G
```

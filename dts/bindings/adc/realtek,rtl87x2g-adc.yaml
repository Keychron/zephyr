## dts/bindings/adc/realtek,rtl87x2g-adc.yaml
```yaml
# Copyright(c) 2020, Realtek Semiconductor Corporation.
# SPDX-License-Identifier: Apache-2.0

description: |
  RTL87X2G ADC.
  The RTL87X2G ADC has 8 channels. Pinctrl must be configured as "SW_MODE" while using ADC.
  P2_0 to P2_7 could be configured as ADC sampling pins, corresponding to ADC channel 0 to 7.

  Example of devicetree configuration.

  &adc {
    pinctrl-0 = <&adc_default>;
    pinctrl-names = "default";
    #address-cells = <1>;
    #size-cells = <0>;
    status = "okay";
    channel@0 {
        reg = <0>;
        zephyr,gain = "ADC_GAIN_1";
        zephyr,reference = "ADC_REF_INTERNAL";
        zephyr,acquisition-time = <ADC_ACQ_TIME_DEFAULT>;
        zephyr,resolution = <12>;
    };

    channel@1 {
        reg = <1>;
        zephyr,gain = "ADC_GAIN_1";
        zephyr,reference = "ADC_REF_INTERNAL";
        zephyr,acquisition-time = <ADC_ACQ_TIME_DEFAULT>;
        zephyr,resolution = <12>;
    };
  };

  &pinctrl {
    adc_default: adc_default {
        group1 {
            psels = <RTL87X2G_PSEL(SW_MODE, P2_0, DIR_IN, DRV_LOW, PULL_DOWN)>,
            <RTL87X2G_PSEL(SW_MODE, P2_1, DIR_IN, DRV_LOW, PULL_DOWN)>;
        };
    };
  };

compatible: "realtek,rtl87x2g-adc"

include: [adc-controller.yaml, pinctrl-device.yaml]

properties:
  reg:
    required: true

  clocks:
    required: true

  channels:
    type: int
    description: Number of external channels
    required: true

  interrupts:
    required: true

  "#io-channel-cells":
    const: 1

  pinctrl-0:
    required: true

  pinctrl-names:
    required: true

  is-bypass-mode:
    type: int
    default: 0
    description: |
      This is a channel map to configure bypass/divide mode for each adc channel.
      For example, configure 0x05 means channel0 and channel2 are configured as bypass mode,
      and other channels are configured as divide mode by default.
      In "divide mode" the ADC range is 0 to 3.3V.
      In "bypass mode" the ADC range is 0 to 0.9V.

io-channel-cells:
  - input
```
